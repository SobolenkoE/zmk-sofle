## Kconfig
```kconfig
# Пользовательские behaviors (подхватываются как ZMK_EXTRA_MODULES)

config ZMK_BEHAVIOR_ENC_WHEEL
	bool "Encoder wheel scroll behavior"
	default y if DT_HAS_ZMK_BEHAVIOR_ENC_WHEEL_ENABLED
	depends on ZMK_POINTING
```

## dts/bindings/behavior/zmk,behavior-enc-wheel.yaml
```yaml
description: |
    Мгновенные HID wheel-события для энкодера (обход race в &msc на ZMK main).
    Параметр: число шагов, отрицательное = вниз.

compatible: "zmk,behavior-enc-wheel"

properties:
  "#binding-cells":
    type: int
    required: true
    const: 1
```
